## boards/arm/thingy53_nrf5340/Kconfig.sysbuild
```kconfig
choice BOOTLOADER
        default BOOTLOADER_MCUBOOT
endchoice

config NETCORE_APP_UPDATE
	default y if (NETCORE_HCI_RPMSG || NETCORE_802154_RPMSG)

config SECURE_BOOT
	default y if (NETCORE_HCI_RPMSG || NETCORE_802154_RPMSG)

choice SECURE_BOOT_CORE
	default SECURE_BOOT_NETCORE if (NETCORE_HCI_RPMSG || NETCORE_802154_RPMSG)
endchoice
```

## subsys/mgmt/mcumgr/Kconfig
```kconfig
# Copyright Runtime.io 2018. All rights reserved.
# Copyright Nordic Semiconductor ASA 2020-2022. All rights reserved.
# SPDX-License-Identifier: Apache-2.0

menuconfig MCUMGR
	bool "mcumgr Support"
	depends on NET_BUF
	depends on ZCBOR
	depends on CRC
	imply BOOT_IMAGE_ACCESS_HOOKS if (SOC_NRF5340_CPUAPP_QKAA && MCUMGR_GRP_IMG)
	help
	  This option enables the mcumgr management library.

if MCUMGR

module = MCUMGR
module-str = mcumgr
source "subsys/logging/Kconfig.template.log_config"

rsource "mgmt/Kconfig"

rsource "smp/Kconfig"

config MCUMGR_SMP_LEGACY_RC_BEHAVIOUR
	bool "Legacy rc (result code) response behaviour"
	depends on MCUMGR_SMP_SUPPORT_ORIGINAL_PROTOCOL
	help
	  This will enable legacy result code response behaviour of having rc
	  present in responses when the status is 0. With this option disabled,
	  mcumgr acts with new behaviour and will only return rc is the result
	  code is non-zero (i.e. an error occurred).

	  If a command only returns a result code, this will mean that the
	  response will be empty with the new behaviour enabled, as opposed to
	  the old behaviour where the rc field will be present in the response.

config SMP_CLIENT
	bool "SMP Client support"
	help
	  This will enable SMP Request generation and response handling.

if SMP_CLIENT || ZTEST

config SMP_CMD_DEFAULT_LIFE_TIME
	int "SMP command lifetime in seconds"
	range 2 30
	default 5
	help
	  This define lifetime for SMP client send request. This configure is used if a request
	  with a timeout of 0 is used.

config SMP_CMD_RETRY_TIME
	int "SMP command re-send period in ms"
	range 100 1000
	default 500
	help
	  The time (in ms) which the SMP client will wait for a response before re-sending
	  a command.

config SMP_CLIENT_CMD_MAX
	int "SMP client max buffer count"
	default 4
	help
	  Define how many active requests that the client can handle

endif # SMP_CLIENT

menu "Command Handlers"

rsource "grp/Kconfig"

endmenu

menu "Transports and Transport Related Configuration Options"

rsource "transport/Kconfig"

endmenu

endif # MCUMGR
```
