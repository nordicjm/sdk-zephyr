&mx25r64 {
        partitions {
/*
                slot2_partition: partition@e0000 {
                        label = "image-2";
                        reg = <0x000e0000 0x00040000>;
                };
*/

                slot2_partition: partition@120000 {
                        label = "image-3";
                        reg = <0x00120000 0x00040000>;
                };
        };
};
