/*
    | nRF9160     |                            |    nRF52840    |
    | RTS   P0.17 | -- nRF interface line 0 -- | P0.17  CTS     |
    |       P0.18 | -- nRF interface line 1 -- | P0.20          |
    |       P0.19 | -- nRF interface line 2 -- | P0.15          |
    | RX    P0.21 | -- nRF interface line 3 -- | P0.22  TX      |
    | CTS   P0.22 | -- nRF interface line 4 -- | P1.04  RTS     |
    | TX    P0.23 | -- nRF interface line 5 -- | P1.02  RX      |
    |       COEX0 | -- nRF interface line 6 -- | P1.13          |
    |       COEX1 | -- nRF interface line 7 -- | P1.11          |
    |       COEX2 | -- nRF interface line 8 -- | P1.15          |
    |       P0.24 | -- nRF interface line 9 -- | P0.18 (nRESET) | (in v0.14.0 or later)
*/

&nrf_interface_pin_9_routing {

	status = "okay";
};